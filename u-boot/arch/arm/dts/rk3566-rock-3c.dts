/*
 * SPDX-License-Identifier:     GPL-2.0+
 *
 * (C) Copyright 2020 Rockchip Electronics Co., Ltd
 */

/dts-v1/;
#include "rk3568.dtsi"
#include "rk3568-u-boot.dtsi"
#include <dt-bindings/input/input.h>

/ {
	model = "Radxa ROCK3 Model C";
	compatible = "radxa,rock3c", "rockchip,rk3568";
};
